## fs/nfsrust/Kconfig
```kconfig
# SPDX-License-Identifier: GPL-2.0

menuconfig NFS_RUST
	bool "Rust NFSv3 Implementation"
	depends on RUST
	help
	  You can build sample Rust kernel code here.

	  If unsure, say N.

if NFS_RUST

config NFS_RUST_SAMPLE_MINIMAL
	tristate "Minimal"
	help
	  This option builds the Rust minimal module sample.

	  To compile this as a module, choose M here:
	  the module will be called rust_minimal.

	  If unsure, say N.

config NFS_RUST_SAMPLE_PRINT
	tristate "Printing macros"
	help
	  This option builds the Rust printing macros sample.

	  To compile this as a module, choose M here:
	  the module will be called rust_print.

	  If unsure, say N.

config NFS_RUST_SAMPLE_HOSTPROGS
	bool "Host programs"
	help
	  This option builds the Rust host program samples.

	  If unsure, say N.

endif # NFS_RUST
```
